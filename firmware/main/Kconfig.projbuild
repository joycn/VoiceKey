## firmware/main/Kconfig.projbuild
```kconfig
menu "VoiceKey"
config VOICEKEY_SPATIAL
    bool "Enable experimental single-sector first-speaker mode at boot"
    default n
    help
        Enables device-native 0 +/-30 degrees, 250ms confirmation and 2s lease.
        Calibrate orientation before use. Firmware C APIs can configure up to
        eight regions and manual/keyword policies. No acoustic isolation guarantee.
config VOICEKEY_PCM_GAIN
    int "PCM integer gain (saturating)"
    range 1 8
    default 1
config VOICEKEY_COOLDOWN_MS
    int "Wake/button trigger cooldown (ms)"
    range 500 10000
    default 2000
config VOICEKEY_USB_VID
    hex "USB VID (0xCAFE is development only)"
    default 0xCAFE
config VOICEKEY_USB_PID
    hex "USB PID (development only)"
    default 0x4014
endmenu
```

## firmware/sdkconfig.defaults
```kconfig
CONFIG_IDF_TARGET="esp32s3"
CONFIG_ESPTOOLPY_FLASHSIZE_8MB=y
CONFIG_ESPTOOLPY_FLASHMODE_QIO=y
CONFIG_PARTITION_TABLE_CUSTOM=y
CONFIG_PARTITION_TABLE_CUSTOM_FILENAME="partitions.csv"
CONFIG_SPIRAM=y
CONFIG_SPIRAM_MODE_OCT=y
CONFIG_SPIRAM_SPEED_80M=y
CONFIG_SPIRAM_USE_MALLOC=y
CONFIG_ESP_DEFAULT_CPU_FREQ_MHZ_240=y
CONFIG_FREERTOS_HZ=1000
# Living-room baseline: all-direction capture, no extra digital amplification.
# CONFIG_VOICEKEY_SPATIAL is not set
CONFIG_VOICEKEY_PCM_GAIN=1
CONFIG_ESP_CONSOLE_NONE=y
CONFIG_ESP_CONSOLE_SECONDARY_NONE=y
CONFIG_MODEL_IN_FLASH=y
CONFIG_SR_WN_WN9_HILEXIN=n
# CONFIG_SR_WN_WN9_HIESP is not set
CONFIG_SR_MN_EN_NONE=y
CONFIG_SR_MN_CN_NONE=y

# CONFIG_SR_WN_WN9_HIJOY_TTS is not set

CONFIG_SR_WN_WN9_NIHAOXIAOZHI_TTS=y
```
